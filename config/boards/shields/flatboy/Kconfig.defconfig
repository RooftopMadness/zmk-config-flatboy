## config/boards/shields/flatboy/Kconfig.defconfig
```kconfig
if SHIELD_CHIPPY_LEFT

    config ZMK_KEYBOARD_NAME
        default "FlatBoye"

    config ZMK_SPLIT
        default y

    config ZMK_SPLIT_BLE_ROLE_CENTRAL
        default y

endif

if SHIELD_CHIPPY_RIGHT

    config ZMK_KEYBOARD_NAME
        default "FlatBoye R"

    config ZMK_SPLIT
        default y

    config ZMK_SPLIT_BLE_ROLE_CENTRAL
        default n
	
endif

if SHIELD_SETTINGS_RESET

config ZMK_KEYBOARD_NAME
	default "SETTINGS RESET"

endif
```
